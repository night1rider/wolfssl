## zephyr/samples/wolfssl_tls_thread/sample.yaml
```yaml
sample:
  description: wolfSSL TLS test application
  name: wolfSSL TLS Test
common:
  harness: console
  harness_config:
    type: multi_line
    regex:
      - "Server Return: 0"
      - "Server Error: 0"
      - "Client Return: 0"
      - "Client Error: 0"
tests:
  sample.crypto.wolfssl_tls_thread:
    timeout: 60
    platform_allow:
      - qemu_x86
      - qemu_x86/atom
      - native_sim
      - native_sim/native/64
    integration_platforms:
      - qemu_x86
```
